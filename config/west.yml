## config/west.yml
```yaml
manifest:
  remotes:
    - name: zmkfirmware
      url-base: https://github.com/zmkfirmware
    - name: tdorzhi
      url-base: https://github.com/tdorzhi
  projects:
    - name: zmk
      remote: tdorzhi
      revision: sofle
      import: app/west.yml
  self:
    path: config
```
